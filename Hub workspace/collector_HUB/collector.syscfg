/**
 * @cliArgs --board "/ti/boards/LP_EM_CC1314R10" --rtos "tirtos7" --product "simplelink_cc13xx_cc26xx_sdk@7.41.00.17"
 * @versions {"tool":"1.18.1+3343"}
 */

/**
 * Import the modules used in this configuration.
 */
const CCFG         = scripting.addModule("/ti/devices/CCFG");
const rfdesign     = scripting.addModule("/ti/devices/radioconfig/rfdesign");
const Display      = scripting.addModule("/ti/display/Display");
const Display1     = Display.addInstance();
const NVS          = scripting.addModule("/ti/drivers/NVS");
const NVS1         = NVS.addInstance();
const NVS2         = NVS.addInstance();
const RF           = scripting.addModule("/ti/drivers/RF");
const Button       = scripting.addModule("/ti/drivers/apps/Button");
const Button1      = Button.addInstance();
const Button2      = Button.addInstance();
const LED          = scripting.addModule("/ti/drivers/apps/LED");
const LED1         = LED.addInstance();
const LED2         = LED.addInstance();
const Settings     = scripting.addModule("/ti/posix/tirtos/Settings");
const BIOS         = scripting.addModule("/ti/sysbios/BIOS");
const Boot         = scripting.addModule("/ti/sysbios/family/arm/cc26xx/Boot");
const Hwi          = scripting.addModule("/ti/sysbios/family/arm/v8m/Hwi");
const GateMutexPri = scripting.addModule("/ti/sysbios/gates/GateMutexPri");
const HeapCallback = scripting.addModule("/ti/sysbios/heaps/HeapCallback");
const Clock        = scripting.addModule("/ti/sysbios/knl/Clock");
const Idle         = scripting.addModule("/ti/sysbios/knl/Idle");
const Idle2        = Idle.addInstance();
const Semaphore    = scripting.addModule("/ti/sysbios/knl/Semaphore");
const Swi          = scripting.addModule("/ti/sysbios/knl/Swi");
const Task         = scripting.addModule("/ti/sysbios/knl/Task");
const Error        = scripting.addModule("/ti/sysbios/runtime/Error");
const Memory       = scripting.addModule("/ti/sysbios/runtime/Memory");
const SysCallback  = scripting.addModule("/ti/sysbios/runtime/SysCallback");
const System       = scripting.addModule("/ti/sysbios/runtime/System");
const ti154stack   = scripting.addModule("/ti/ti154stack/ti154stack");

/**
 * Write custom configuration values to the imported modules.
 */
CCFG.xoscCapArray             = true;
CCFG.xoscCapArrayDelta        = 0xD5;
CCFG.enableBootloader         = true;
CCFG.enableBootloaderBackdoor = true;
CCFG.dioBootloaderBackdoor    = 15;
CCFG.levelBootloaderBackdoor  = "Active low";
CCFG.ccfgTemplate.$name       = "ti_devices_CCFG_CCFGCC26XXTemplate0";

rfdesign.rfDesign = "LP_EM_CC1314R10";

Display1.$hardware  = system.deviceData.board.components.XDS110UART;
Display1.$name      = "CONFIG_DISPLAY";
Display1.uart.$name = "CONFIG_DISPLAY_UART";

NVS1.$name                    = "CONFIG_NVSINTERNAL";
NVS1.internalFlash.$name      = "ti_drivers_nvs_NVSCC26XX0";
NVS1.internalFlash.regionBase = 0x4E000;
NVS1.internalFlash.regionSize = 0x8000;

NVS2.$name                    = "CONFIG_NVS_CUSTOM";
NVS2.internalFlash.$name      = "ti_drivers_nvs_NVSCC26XX1";
NVS2.internalFlash.regionSize = 0x8000;
NVS2.internalFlash.regionBase = 0xE1000;

Button1.$hardware     = system.deviceData.board.components["BTN-1"];
Button1.$name         = "CONFIG_BTN_LEFT";
Button1.gpioPin.$name = "CONFIG_GPIO_BTN1";
Button1.gpioPin.pull  = "Pull Up";

Button2.$hardware     = system.deviceData.board.components["BTN-2"];
Button2.$name         = "CONFIG_BTN_RIGHT";
Button2.gpioPin.$name = "CONFIG_GPIO_BTN2";
Button2.gpioPin.pull  = "Pull Up";

LED1.$hardware     = system.deviceData.board.components.LED_RED;
LED1.$name         = "CONFIG_LED_RED";
LED1.gpioPin.$name = "CONFIG_GPIO_RLED";

LED2.$hardware     = system.deviceData.board.components.LED_GREEN;
LED2.$name         = "CONFIG_LED_GREEN";
LED2.gpioPin.$name = "CONFIG_GPIO_GLED";

BIOS.assertsEnabled = false;
BIOS.rtsGateType    = "BIOS_GateMutexPri";
BIOS.heapSize       = 0x00000000;
BIOS.heapType       = "HeapCallback";

Hwi.excHandlerFunc = "Main_excHandler";
Hwi.nvicCCR        = [];

HeapCallback.initFxn           = "osalHeapInitFxn";
HeapCallback.allocInstFxn      = "osalHeapAllocFxn";
HeapCallback.freeInstFxn       = "osalHeapFreeFxn";
HeapCallback.getStatsInstFxn   = "osalHeapGetStatsFxn";
HeapCallback.isBlockingInstFxn = "osalHeapIsBlockingFxn";

Clock.tickPeriod  = 10;
Clock.swiPriority = 4;

const Timer = scripting.addModule("/ti/sysbios/family/arm/v8m/cc26x4/Timer", {}, false);

Idle2.$name   = "powerIdle";
Idle2.idleFxn = "Power_idleFunc";

Semaphore.supportsPriority = false;

Swi.numPriorities = 6;

Task.checkStackFlag    = false;
Task.defaultStackSize  = 512;
Task.idleTaskStackSize = 512;
Task.numPriorities     = 6;

Error.policy = "Error_SPIN";

System.abortFxn          = "System_abortSpin";
System.exitFxn           = "System_exitSpin";
System.maxAtexitHandlers = 1;
System.supportModule     = "SysCallback";

ti154stack.lockProject                        = true;
ti154stack.transmitPower                      = "5";
ti154stack.reportingInterval                  = 10000;
ti154stack.trackingDelayTime                  = 10000;
ti154stack.pollingInterval                    = 800;
ti154stack.radioConfig.codeExportConfig.$name = "ti_devices_radioconfig_code_export_param0";
ti154stack.aesccmModule.$name                 = "CONFIG_AESCCM_0";
ti154stack.ti154stackModule.$name             = "ti_ti154stack_ti154stack_config_mod0";

/**
 * Pinmux solution for unlocked pins/peripherals. This ensures that minor changes to the automatic solver in a future
 * version of the tool will not impact the pinmux you originally saw.  These lines can be completely deleted in order to
 * re-solve from scratch.
 */
Display1.uart.uart.$suggestSolution       = "UART1";
Display1.uart.uart.txPin.$suggestSolution = "boosterpack.4";
Display1.uart.uart.rxPin.$suggestSolution = "boosterpack.3";
Button1.button.$suggestSolution           = "boosterpack.11";
Button2.button.$suggestSolution           = "boosterpack.17";
LED1.ledPin.$suggestSolution              = "DIO_6";
LED2.ledPin.$suggestSolution              = "DIO_7";
Timer.rtc.$suggestSolution                = "RTC0";
